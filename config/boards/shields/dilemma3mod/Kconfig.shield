## config/boards/shields/dilemma3mod/Kconfig.shield
```kconfig
config SHIELD_DILEMMA3MOD_LEFT
    def_bool $(shields_list_contains,dilemma3mod_left)

config SHIELD_DILEMMA3MOD_RIGHT
    def_bool $(shields_list_contains,dilemma3mod_right)
```
